## sdkconfig.defaults
```kconfig
# ----------------------------------------------------------------------
# 1. HARDWARE & FLASH SETUP (CYD Specifics)
# ----------------------------------------------------------------------
# Force 240MHz CPU for maximum Link timing accuracy
CONFIG_ESP_DEFAULT_CPU_FREQ_MHZ_240=y
CONFIG_ESP_DEFAULT_CPU_FREQ_MHZ=240

# CYD has 4MB Flash. We use QIO 80MHz for fastest code execution.
# (If your board fails to boot, switch QIO to DIO)
CONFIG_ESPTOOLPY_FLASHSIZE_4MB=y
CONFIG_ESPTOOLPY_FLASHMODE_QIO=y
CONFIG_ESPTOOLPY_FLASHFREQ_80M=y

# ----------------------------------------------------------------------
# 2. PARTITION TABLE & COMPILER (Large App Support)
# ----------------------------------------------------------------------
# Use "Single Factory App, No OTA" layout.
# This gives ~3MB to the app, needed for ASIO + Link + LovyanGFX.
CONFIG_PARTITION_TABLE_SINGLE_APP_LARGE=y

# Enable C++ Exceptions & RTTI (REQUIRED for ASIO/Link to work)
CONFIG_COMPILER_CXX_EXCEPTIONS=y
CONFIG_COMPILER_CXX_RTTI=y

# Default optimization (balanced)
CONFIG_COMPILER_OPTIMIZATION_DEFAULT=y

# Keep assertions enabled for stability
CONFIG_COMPILER_OPTIMIZATION_ASSERTIONS_ENABLE=y

# Stack overflow checking
CONFIG_FREERTOS_CHECK_STACKOVERFLOW_CANARY=y

# ----------------------------------------------------------------------
# 3. WIFI & NETWORKING (Optimized for 10 Link Peers + Web Portal)
# ----------------------------------------------------------------------
# Socket limits: Right-sized for Link peers + web portal
CONFIG_LWIP_MAX_SOCKETS=32

# Enable Multicast (IGMP) so Link peers can find each other
CONFIG_LWIP_IGMP=y
CONFIG_LWIP_SO_REUSE=y
CONFIG_LWIP_SO_REUSE_RXTOALL=y

# WiFi Buffers: TX increased for Link multicast bursts with multiple peers
CONFIG_ESP_WIFI_STATIC_RX_BUFFER_NUM=10
CONFIG_ESP_WIFI_DYNAMIC_RX_BUFFER_NUM=64
CONFIG_ESP_WIFI_DYNAMIC_TX_BUFFER_NUM=64

# Place WiFi functions in RAM (IRAM) to prevent stutter during Flash writes
CONFIG_ESP_WIFI_RX_IRAM_OPT=y
CONFIG_ESP_WIFI_IRAM_OPT=y

# DHCP Server: Allow 10 AP clients (for web portal access)
CONFIG_LWIP_DHCPS_MAX_STATION_NUM=10

# ----------------------------------------------------------------------
# 4. UDP TUNING (Ableton Link Critical - 10 Peers)
# ----------------------------------------------------------------------
# UDP PCB pool: Right-sized for Link peers
CONFIG_LWIP_MAX_UDP_PCBS=32

# UDP mailbox for Link messages
CONFIG_LWIP_UDP_RECVMBOX_SIZE=128

# TCP/IP task mailbox
CONFIG_LWIP_TCPIP_RECVMBOX_SIZE=128

# ----------------------------------------------------------------------
# 5. TCP TUNING (Web Portal Optimization)
# ----------------------------------------------------------------------
# TCP connections for web clients
CONFIG_LWIP_MAX_ACTIVE_TCP=16
CONFIG_LWIP_MAX_LISTENING_TCP=8
CONFIG_LWIP_TCP_RECVMBOX_SIZE=6
CONFIG_LWIP_TCP_ACCEPTMBOX_SIZE=6

# Faster TCP timeouts for captive portal responsiveness
CONFIG_LWIP_TCP_FIN_WAIT_TIMEOUT=10000

# ----------------------------------------------------------------------
# 6. TASK CONFIGURATION
# ----------------------------------------------------------------------
# Pin Link tasks to Core 1 (separate from WiFi on Core 0)
CONFIG_LINK_ESP_TASK_CORE_ID=1

# ----------------------------------------------------------------------
# 7. MULTICAST OPTIMIZATION (Link Discovery)
# ----------------------------------------------------------------------
# IGMP for Link multicast
CONFIG_LWIP_ESP_MLDV6_REPORT=y

# ----------------------------------------------------------------------
# 8. CLEANUP
# ----------------------------------------------------------------------
# Disable Bluetooth to save RAM/Flash (We only use WiFi)
CONFIG_BT_ENABLED=n

# Clean up dead TCP connections (Captive Portal) faster
CONFIG_LWIP_TCP_MSL=3000


# Enable the Socket Send Buffer
CONFIG_LWIP_SO_SNDBUF=y
CONFIG_LWIP_SO_RCVBUF=y


# Set a healthy default (default is often too low, like 2KB or 0)
# 4096 or 8192 is usually the sweet spot for Link multicast bursts
CONFIG_LWIP_SO_SND_RCV_BUFF_SIZE=8192
CONFIG_ESP_WIFI_TX_BA_WIN=6
```
